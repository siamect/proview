/* 
 * Proview   Open Source Process Control.
 * Copyright (C) 2005-2014 SSAB EMEA AB.
 *
 * This file is part of Proview.
 *
 * This program is free software; you can redistribute it and/or 
 * modify it under the terms of the GNU General Public License as 
 * published by the Free Software Foundation, either version 2 of 
 * the License, or (at your option) any later version.
 *
 * This program is distributed in the hope that it will be useful 
 * but WITHOUT ANY WARRANTY; without even the implied warranty of 
 * MERCHANTABILITY or FITNESS FOR A PARTICULAR PURPOSE. See the 
 * GNU General Public License for more details.
 *
 * You should have received a copy of the GNU General Public License 
 * along with Proview. If not, see <http://www.gnu.org/licenses/>
 *
 * Linking Proview statically or dynamically with other modules is
 * making a combined work based on Proview. Thus, the terms and 
 * conditions of the GNU General Public License cover the whole 
 * combination.
 *
 * In addition, as a special exception, the copyright holders of
 * Proview give you permission to, from the build function in the
 * Proview Configurator, combine Proview with modules generated by the
 * Proview PLC Editor to a PLC program, regardless of the license
 * terms of these modules. You may copy and distribute the resulting
 * combined work under the terms of your choice, provided that every 
 * copy of the combined work is accompanied by a complete copy of 
 * the source code of Proview (the version used to produce the 
 * combined work), being distributed under the terms of the GNU 
 * General Public License plus this exception.
 */

/* rt_io_m_gertboard.c -- I/O methods for class Gertboard. */

#include "pwr.h"
#include "pwr_basecomponentclasses.h"
#include "pwr_otherioclasses.h"
#include "co_time.h"
#include "rt_io_base.h"
#include "rt_io_card_init.h"
#include "rt_io_card_close.h"
#include "rt_io_card_read.h"
#include "rt_io_card_write.h"
#include "rt_io_msg.h"
#include "rt_io_gb_common.h"
#include "rt_io_gb_spi.h"

#define GPIO_CHANNELS 12
#define AD0_CHANNEL 12
#define AD1_CHANNEL 13
#define DA0_CHANNEL 14
#define DA1_CHANNEL 15

typedef struct {
  FILE *value_fp[GPIO_CHANNELS];
  unsigned int number[GPIO_CHANNELS];
  unsigned int mask[GPIO_CHANNELS];
  int type[GPIO_CHANNELS];
  unsigned int in_mask;
  unsigned int out_mask;
  int interval_cnt;
  int has_read_method;
} io_sLocalGertboard;

static pwr_tStatus IoCardInit( io_tCtx ctx,
			       io_sAgent *ap,
			       io_sRack *rp,
			       io_sCard *cp)
{
  int i;
  pwr_sClass_Gertboard *op = (pwr_sClass_Gertboard *)cp->op;
  io_sLocalGertboard *local;
  int spi_init = 0;

  local = (io_sLocalGertboard *) calloc( 1, sizeof(io_sLocalGertboard));
  cp->Local = local;

  setup_io();

  if ( (cp->chanlist[AD0_CHANNEL].cop && cp->chanlist[AD0_CHANNEL].sop) ||
       (cp->chanlist[AD1_CHANNEL].cop && cp->chanlist[AD1_CHANNEL].sop) ||
       (cp->chanlist[DA0_CHANNEL].cop && cp->chanlist[DA0_CHANNEL].sop) ||
       (cp->chanlist[DA1_CHANNEL].cop && cp->chanlist[DA1_CHANNEL].sop)) {
    // Init SPI
    INP_GPIO(7);  
    SET_GPIO_ALT(7,0);
    INP_GPIO(8);  
    SET_GPIO_ALT(8,0);
    INP_GPIO(9);  
    SET_GPIO_ALT(9,0);
    INP_GPIO(10); 
    SET_GPIO_ALT(10,0);
    INP_GPIO(11); 
    SET_GPIO_ALT(11,0);

    setup_spi();
    spi_init = 1;
  }

  for ( i = 0; i < GPIO_CHANNELS; i++) {
    if ( cp->chanlist[i].cop && cp->chanlist[i].sop) {
      switch( cp->chanlist[i].ChanClass) {
      case pwr_cClass_ChanD:
	if ( local->number[i] > 32) {
	  errh_Error("Gertboard channel number error, Buf%d", i+1);
	  op->Status = IO__INITFAIL;
	  return IO__INITFAIL;
	}
	local->type[i] = ((pwr_sClass_ChanD *)cp->chanlist[i].cop)->Type;
	local->number[i] = ((pwr_sClass_ChanD *)cp->chanlist[i].cop)->Number;

	if ( spi_init && (local->number[i] == 7 || local->number[i] == 8 || 
			  local->number[i] == 9 || local->number[i] == 10 || 
			  local->number[i] == 11)) {
	  errh_Warning("GPIO Buf and SPI overlap, %d", local->number[i]);
	  break;
	}

	local->mask[i] = 1 << local->number[i];

	if ( local->type[i] == pwr_eDChanTypeEnum_Di) {
	  local->in_mask |= local->mask[i];
	  INP_GPIO(local->number[i]);
	}
	else {
	  local->out_mask |= local->mask[i];
	  INP_GPIO(local->number[i]);
	  OUT_GPIO(local->number[i]);
	}
	break;
      default: ;
      }
    }
  }

  if ( local->in_mask) {
    GPIO_PULL = 2;
    short_wait();
    GPIO_PULLCLK0 = local->in_mask;
    short_wait();
    GPIO_PULL = 0;
    GPIO_PULLCLK0 = 0;
  }
  
  if ( cp->chanlist[DA0_CHANNEL].cop && cp->chanlist[AD0_CHANNEL].sop) {
    io_AiRangeToCoef( &cp->chanlist[AD0_CHANNEL]);
  }
  if ( cp->chanlist[DA1_CHANNEL].cop && cp->chanlist[AD1_CHANNEL].sop) {
    io_AiRangeToCoef( &cp->chanlist[AD1_CHANNEL]);
  }

  if ( cp->chanlist[DA0_CHANNEL].cop && cp->chanlist[DA0_CHANNEL].sop) {
    io_AoRangeToCoef( &cp->chanlist[DA0_CHANNEL]);
  }
  if ( cp->chanlist[DA1_CHANNEL].cop && cp->chanlist[DA1_CHANNEL].sop) {
    io_AoRangeToCoef( &cp->chanlist[DA1_CHANNEL]);
  }


  errh_Info( "Init of Gertboard '%s'", cp->Name);
  op->Status = IO__SUCCESS;

  return IO__SUCCESS;
}

static pwr_tStatus IoCardClose( io_tCtx ctx,
			        io_sAgent *ap,
			        io_sRack *rp,
			        io_sCard *cp)
{
  io_sLocalGertboard *local = (io_sLocalGertboard *)cp->Local;
  pwr_sClass_Gertboard *op = (pwr_sClass_Gertboard *)cp->op;

  if ( local->in_mask) {
    GPIO_PULL = 0;
    short_wait();
    GPIO_PULLCLK0 = local->in_mask;
    short_wait();
    GPIO_PULL = 0;
    GPIO_PULLCLK0 = 0;
  }

  free( cp->Local);
  op->Status = 0;

  return IO__SUCCESS;
}

static pwr_tStatus IoCardRead( io_tCtx ctx,
			       io_sAgent *ap,
			       io_sRack	*rp,
			       io_sCard	*cp)
{
  io_sLocalGertboard *local = (io_sLocalGertboard *)cp->Local;
  int i;
  unsigned int value_mask;
  int ivalue;

  value_mask = GPIO_IN0;

  for ( i = 0; i < GPIO_CHANNELS; i++) {
    if ( local->mask[i] & local->in_mask && cp->chanlist[i].cop && cp->chanlist[i].vbp) {
      if ( value_mask & local->mask[i])
	*(pwr_tBoolean *)cp->chanlist[i].vbp = 1;
      else
	*(pwr_tBoolean *)cp->chanlist[i].vbp = 0;
    }
  }
  for ( i = 0; i < 2; i++) {
    if ( cp->chanlist[AD0_CHANNEL+i].cop && cp->chanlist[AD0_CHANNEL+i].sop) {
      io_sChannel *chanp = &cp->chanlist[AD0_CHANNEL + i];
      pwr_sClass_ChanAi *cop = (pwr_sClass_ChanAi *)chanp->cop;
      pwr_sClass_Ai *sop = (pwr_sClass_Ai *)chanp->sop;
      float actvalue;

      if ( cop->CalculateNewCoef)
	// Request to calculate new coefficients
	io_AiRangeToCoef( chanp);
      
      ivalue = read_adc(i);
      io_ConvertAi( cop, ivalue, &actvalue);

      // Filter
      if ( sop->FilterType == 1 &&
	   sop->FilterAttribute[0] > 0 &&
	   sop->FilterAttribute[0] > ctx->ScanTime) {
	actvalue = *(pwr_tFloat32 *)chanp->vbp + ctx->ScanTime / sop->FilterAttribute[0] *
	  (actvalue - *(pwr_tFloat32 *)chanp->vbp);
      }
      
      *(pwr_tFloat32 *)chanp->vbp = actvalue;
      sop->SigValue = cop->SigValPolyCoef1 * ivalue + cop->SigValPolyCoef0;
      sop->RawValue = ivalue;
    }
  }

  return IO__SUCCESS;
}

static pwr_tStatus IoCardWrite( io_tCtx ctx,
			       io_sAgent *ap,
			       io_sRack	*rp,
			       io_sCard	*cp)
{
  io_sLocalGertboard *local = (io_sLocalGertboard *)cp->Local;
  int i;
  unsigned int clear_mask = 0;
  unsigned int set_mask = 0;
  int ivalue;

  for ( i = 0; i < GPIO_CHANNELS; i++) {
    if ( local->mask[i] & local->out_mask && cp->chanlist[i].cop && cp->chanlist[i].vbp) {
      if ( *(pwr_tBoolean *)cp->chanlist[i].vbp)
	set_mask |= local->mask[i];
      else
	clear_mask |= local->mask[i];
    }
  }
  GPIO_CLR0 = clear_mask;
  GPIO_SET0 = set_mask;

  for ( i = 0; i < 2; i++) {
    if ( cp->chanlist[DA0_CHANNEL+i].cop && cp->chanlist[DA0_CHANNEL+i].sop) {
      pwr_sClass_ChanAo *cop = (pwr_sClass_ChanAo *)cp->chanlist[DA0_CHANNEL+i].cop;
      pwr_sClass_Ao *sop = (pwr_sClass_Ao *)cp->chanlist[DA0_CHANNEL+i].sop;

      if ( cop->CalculateNewCoef)
	// Request to calculate new coefficients
	io_AoRangeToCoef( &cp->chanlist[DA0_CHANNEL+i]);

      ivalue = (int)( *(pwr_tFloat32 *)cp->chanlist[DA0_CHANNEL+i].vbp * 
		      cop->OutPolyCoef1 + cop->OutPolyCoef0 + 0.5);
      if ( ivalue < 0)
	ivalue = 0;
      else if (ivalue > 4095)
	ivalue = 4095;
      sop->RawValue = ivalue;
      sop->SigValue = *(pwr_tFloat32 *)cp->chanlist[DA0_CHANNEL+i].vbp * cop->SigValPolyCoef1  
	+ cop->SigValPolyCoef0;

      write_dac( i, ivalue);
    }
  }

  return IO__SUCCESS;
}

/*  Every method should be registred here. */

pwr_dExport pwr_BindIoMethods(Gertboard) = {
  pwr_BindIoMethod(IoCardInit),
  pwr_BindIoMethod(IoCardClose),
  pwr_BindIoMethod(IoCardRead),
  pwr_BindIoMethod(IoCardWrite),
  pwr_NullMethod
};
