/* 
 * Proview   Open Source Process Control.
 * Copyright (C) 2005-2011 SSAB Oxelosund AB.
 *
 * This file is part of Proview.
 *
 * This program is free software; you can redistribute it and/or 
 * modify it under the terms of the GNU General Public License as 
 * published by the Free Software Foundation, either version 2 of 
 * the License, or (at your option) any later version.
 *
 * This program is distributed in the hope that it will be useful 
 * but WITHOUT ANY WARRANTY; without even the implied warranty of 
 * MERCHANTABILITY or FITNESS FOR A PARTICULAR PURPOSE. See the 
 * GNU General Public License for more details.
 *
 * You should have received a copy of the GNU General Public License 
 * along with Proview. If not, see <http://www.gnu.org/licenses/>
 *
 * Linking Proview statically or dynamically with other modules is
 * making a combined work based on Proview. Thus, the terms and 
 * conditions of the GNU General Public License cover the whole 
 * combination.
 *
 * In addition, as a special exception, the copyright holders of
 * Proview give you permission to, from the build function in the
 * Proview Configurator, combine Proview with modules generated by the
 * Proview PLC Editor to a PLC program, regardless of the license
 * terms of these modules. You may copy and distribute the resulting
 * combined work under the terms of your choice, provided that every 
 * copy of the combined work is accompanied by a complete copy of 
 * the source code of Proview (the version used to produce the 
 * combined work), being distributed under the terms of the GNU 
 * General Public License plus this exception.
 */

/* rt_io_m_spi_slave.c -- I/O methods for SPI */

#include <stdio.h>
#include <errno.h>
#include <string.h>
#include <stdlib.h>
#include <errno.h>
#include <fcntl.h>
#include <sys/ioctl.h>
#include <sys/types.h>
#include <sys/stat.h>
#include <linux/types.h>
#include <linux/spi/spidev.h>

#include "pwr.h"
#include "pwr_basecomponentclasses.h"
#include "pwr_otherioclasses.h"
#include "co_time.h"
#include "co_cdh.h"
#include "rt_io_base.h"
#include "rt_io_bus.h"
#include "rt_io_card_init.h"
#include "rt_io_card_close.h"
#include "rt_io_card_read.h"
#include "rt_io_card_read.h"
#include "rt_io_msg.h"
#include "rt_iom_msg.h"

typedef struct {
  int fd;
  int byte_ordering;
  int float_representation;
  int input_area_size;
  int output_area_size;
  char *input_area;
  char *output_area;
  int softlimit_logged;
  int writeerror_logged;
  int readerror_logged;
  __u8 mode;
} io_sLocalSPI_Slave;


static pwr_tStatus IoCardInit( io_tCtx ctx,
			       io_sAgent *ap,
			       io_sRack *rp,
			       io_sCard *cp)
{
  io_sLocalSPI_Slave *local;
  pwr_sClass_SPI_Slave *op = (pwr_sClass_SPI_Slave *)cp->op;
  unsigned int input_area_offset = 0;
  unsigned int input_area_chansize = 0;
  unsigned int output_area_offset = 0;
  unsigned int output_area_chansize = 0;
  int sts;

  local = (io_sLocalSPI_Slave *) calloc( 1, sizeof(io_sLocalSPI_Slave));
  cp->Local = local;

  op->Status = IOM__UDP_INIT;

  local->fd = open( op->Device, O_RDWR);
  if ( local->fd < 0) {
      errh_Error( "SPI Slave, unable to open device %s, '%s'", op->Device, cp->Name);
      op->Status = IOM__SPI_DEVICE;
      return IO__INITFAIL;
  }

  sts = ioctl( local->fd, SPI_IOC_RD_MODE, &local->mode);
  if ( sts < 0) {
    errh_Error( "SPI Slave, init error errno %d, '%s'", errno, cp->Name);
    op->Status = IOM__SPI_INIT;
    return IO__INITFAIL;
  }

  local->byte_ordering = op->ByteOrdering;
  
  io_bus_card_init( ctx, cp, &input_area_offset, &input_area_chansize,
		    &output_area_offset, &output_area_chansize, local->byte_ordering);

  local->input_area_size = input_area_offset + input_area_chansize;
  local->output_area_size = output_area_offset + output_area_chansize;

  op->InputAreaSize = local->input_area_size;
  op->OutputAreaSize = local->output_area_size;

  if ( local->input_area_size > 0)
    local->input_area = calloc( 1, local->input_area_size);
  if ( local->output_area_size > 0)
    local->output_area = calloc( 1, local->output_area_size);

  errh_Info( "Init of SPI Slave '%s'", cp->Name);
  op->Status = IOM__SPI_NORMAL;

  return IO__SUCCESS;
}

static pwr_tStatus IoCardClose( io_tCtx ctx,
			        io_sAgent *ap,
			        io_sRack *rp,
			        io_sCard *cp)
{
  io_sLocalSPI_Slave *local = (io_sLocalSPI_Slave *)cp->Local;

  close( local->fd);

  if ( local->input_area)
    free( local->input_area);
  if ( local->output_area)
    free( local->output_area);
  if ( cp->Local)
    free( cp->Local);

  return IO__SUCCESS;
}

static pwr_tStatus IoCardRead( io_tCtx ctx,
			       io_sAgent *ap,
			       io_sRack	*rp,
			       io_sCard	*cp)
{
  io_sLocalSPI_Slave *local = (io_sLocalSPI_Slave *)cp->Local;
  pwr_sClass_SPI_Slave *op = (pwr_sClass_SPI_Slave *)cp->op;
  int sts;
  
  sts = read( local->fd, local->input_area, local->input_area_size);
  if ( sts < 0) {
    op->ErrorCount++;
    if ( !local->readerror_logged) {
      errh_Error( "SPI read error errno %d, '%s'", errno, cp->Name);
      local->readerror_logged = 1;
    }
    op->Status = IOM__SPI_READERROR;
  }
  else if ( sts < local->input_area_size) {
    op->ErrorCount++;
    if ( !local->readerror_logged) {
      errh_Error( "SPI read buffer smaller than expected: %d, '%s'", sts, cp->Name);
      local->readerror_logged = 1;
    }
    op->Status = IOM__SPI_READERROR;
  }
  else {
    local->readerror_logged = 0;
    op->Status = IOM__SPI_NORMAL;
    io_bus_card_read( ctx, rp, cp, local->input_area, 0, 
		      local->byte_ordering, pwr_eFloatRepEnum_FloatIEEE);
  }
  
  if ( op->ErrorCount == op->ErrorSoftLimit && !local->softlimit_logged) {
    errh_Warning( "IO Card ErrorSoftLimit reached, '%s'", cp->Name);
    local->softlimit_logged = 1;
  }
  if ( op->ErrorCount >= op->ErrorHardLimit) {
    errh_Error( "IO Card ErrorHardLimit reached '%s', IO stopped", cp->Name);
    ctx->Node->EmergBreakTrue = 1;
    return IO__ERRDEVICE;
  }    

  return IO__SUCCESS;
}

static pwr_tStatus IoCardWrite( io_tCtx ctx,
				io_sAgent *ap,
				io_sRack	*rp,
				io_sCard	*cp)
{
  io_sLocalSPI_Slave *local = (io_sLocalSPI_Slave *)cp->Local;
  pwr_sClass_SPI_Slave *op = (pwr_sClass_SPI_Slave *)cp->op;
  int sts;

  io_bus_card_write( ctx, cp, local->output_area,
		     local->byte_ordering, pwr_eFloatRepEnum_FloatIEEE);
    
  sts = write( local->fd, local->output_area, local->output_area_size);
  if ( sts < 0) {
    op->ErrorCount++;
    if ( !local->writeerror_logged) {
      errh_Error( "SPI write error errno %d, '%s'", errno, cp->Name);
      local->writeerror_logged = 1;
    }
    op->Status = IOM__SPI_WRITEERROR;
  }
  else if ( sts != local->output_area_size) {
    op->ErrorCount++;
    if ( !local->writeerror_logged) {
      errh_Error( "SPI write buffer unexpected size %d, '%s'", sts, cp->Name);
      local->writeerror_logged = 1;
    }
    op->Status = IOM__SPI_WRITEERROR;
  }
  else {
    local->writeerror_logged = 0;
    op->Status = IOM__SPI_NORMAL;
  }

  if ( op->ErrorCount == op->ErrorSoftLimit && !local->softlimit_logged) {
    errh_Warning( "IO Card ErrorSoftLimit reached, '%s'", cp->Name);
    local->softlimit_logged = 1;
  }
  if ( op->ErrorCount >= op->ErrorHardLimit) {
    errh_Error( "IO Card ErrorHardLimit reached '%s', IO stopped", cp->Name);
    ctx->Node->EmergBreakTrue = 1;
    return IO__ERRDEVICE;
  }    

  return IO__SUCCESS;
}


/*  Every method should be registred here. */

pwr_dExport pwr_BindIoMethods(SPI_Slave) = {
  pwr_BindIoMethod(IoCardInit),
  pwr_BindIoMethod(IoCardClose),
  pwr_BindIoMethod(IoCardRead),
  pwr_BindIoMethod(IoCardWrite),
  pwr_NullMethod
};
